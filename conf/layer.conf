## conf/layer.conf
```bitbake
# We have a conf and classes directory, add to BBPATH
BBPATH .= ":${LAYERDIR}"

# We have recipes-* directories, add to BBFILES
BBFILES += "${LAYERDIR}/recipes-*/*/*.bb \
            ${LAYERDIR}/recipes-*/*/*.bbappend"

BBFILE_COLLECTIONS += "meta-raspitemp"
BBFILE_PATTERN_meta-raspitemp = "^${LAYERDIR}/"
BBFILE_PRIORITY_meta-raspitemp = "6"

LAYERDEPENDS_meta-raspitemp = "core"
LAYERSERIES_COMPAT_meta-raspitemp = "mickledore"

# additional packages
IMAGE_INSTALL:append = " vim"

# use uboot
#RPI_USE_U_BOOT = "1"

# enable I2C and load kernel modules
ENABLE_I2C = "1"
KERNEL_MODULE_AUTOLOAD:rpi += "i2c-dev i2c-bcm2708"

# enable serial console and login shell for serial console
ENABLE_UART = "1"
SERIAL_CONSOLES:append = " 115200;ttyAMA0"
```
